/* SPDX-FileCopyrightText: 2024 ETH Zurich and University of Bologna */
/* SPDX-License-Identifier: Apache-2.0 */

/*
 * Host linker script template for CVA6 (RV64IMC).
 *
 * cmake/ChimeraUtils.cmake calls configure_file() on this template to produce
 * the actual linker script.  The placeholder @CHIMERA_LAST_DEVICE@ is replaced
 * with the name of the last device in the chain (e.g. snitch_cluster_1),
 * giving access to its placement symbol __<last_device>_end.
 *
 * Memory layout in memisl (ORIGIN = 0x48000000, LENGTH = 256K):
 *
 *   0x48000000                  ┌─ .common   (host loads, devices NOLOAD)
 *   0x48000000 + common_size    ├─ [snitch_cluster_0 code]
 *   __snitch_cluster_0_end      ├─ [snitch_cluster_1 code]
 *   @CHIMERA_LAST_DEVICE@_end   ├─ .text / .misc / .bss   ← host code here
 *   ORIGIN + LENGTH             └─ host stack (grows downward)
 *
 * The placement file for the last device is INCLUDEd below; it exposes
 * __@CHIMERA_LAST_DEVICE@_end so the .reserved section can skip over all
 * device binaries in one step.
 */

INCLUDE common.ldh
INCLUDE @CHIMERA_LAST_DEVICE@_placement.ldh

/* Global pointer sits in the middle of .misc for GP-relative access */
__global_pointer$ = ADDR(.misc) + SIZEOF(.misc) / 2;
__stack_pointer$  = ORIGIN(memisl) + LENGTH(memisl);
__base_memisl     = ORIGIN(memisl);

SECTIONS {
  /DISCARD/ : { *(.riscv.attributes) *(.comment) }

  /*
   * Shared communication area – host LOADS this section at 0x48000000.
   * Device binaries map the same address as NOLOAD.
   */
  .common : ALIGN(64) {
    __common_start = .;
    KEEP(*(.common))
    KEEP(*(.common.*))
    . = ALIGN(64);
    __common_end = .;
  } > memisl

  /*
   * Skip over all device binaries in one step.
   * __@CHIMERA_LAST_DEVICE@_end is the 4 KiB-aligned end of the last device.
   */
  .reserved (NOLOAD) : {
    . = . + (__@CHIMERA_LAST_DEVICE@_end - ORIGIN(memisl));
  } > memisl

  .text : ALIGN(0x1000) {
    *(.text._start)
    *(.text)
    *(.text.*)
  } > memisl

  .misc : ALIGN(16) {
    *(.rodata)
    *(.rodata.*)
    *(.data)
    *(.data.*)
    *(.srodata)
    *(.srodata.*)
    *(.sdata)
    *(.sdata.*)
  } > memisl

  .bss (NOLOAD) : {
    . = ALIGN(32);
    __bss_start = .;
    *(.bss)
    *(.bss.*)
    *(.sbss)
    *(.sbss.*)
    . = ALIGN(32);
    __bss_end = .;
  } > memisl
}
